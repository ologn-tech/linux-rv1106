## drivers/media/i2c/maxim/local/maxim2c/Kconfig
```kconfig
# SPDX-License-Identifier: GPL-2.0-only
#
# Maxim Dual GMSL deserializer devices
#
config VIDEO_MAXIM_DES_MAXIM2C
	tristate "Maxim Dual GMSL deserializer support"
	depends on VIDEO_MAXIM_SERDES
	help
	  This driver supports the Maxim Dual GMSL2/GMSL1 deserializers:
	  MAX9296, MAX96716 and MAX96718.

	  To compile this driver as a module, choose M here: the
	  module will be called maxim2c.
```

## drivers/media/i2c/maxim/remote/Kconfig
```kconfig
# SPDX-License-Identifier: GPL-2.0-only
#
# Maxim GMSL serializer / remote sensor devices
#

menu "Maxim GMSL Remote Serializer devices support"
	visible if VIDEO_MAXIM_SERDES

config VIDEO_MAXIM_SER_MAX96717
	tristate "Maxim GMSL2 Serializer max96717 support"
	depends on VIDEO_MAXIM_SERDES
	help
	  This driver supports the Maxim GMSL2 max96717 serializer.

	  To compile this driver as a module, choose M here: the
	  module will be called max96717.

endmenu

menu "Maxim GMSL Remote Sensor devices support"
	visible if VIDEO_MAXIM_SERDES

config VIDEO_MAXIM_CAM_OX03J10
	tristate "Maxim Remote Sensor ox03j10 support"
	depends on VIDEO_MAXIM_SERDES
	help
	  This driver supports the remote sensor ox03j10.

	  To compile this driver as a module, choose M here: the
	  module will be called ox03j10.

endmenu
```
