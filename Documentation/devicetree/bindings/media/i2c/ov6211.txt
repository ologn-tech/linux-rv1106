## Documentation/devicetree/bindings/media/i2c/ov6211.txt
```
* Omnivision 1/10.5-Inch 160 Kpixel CMOS Digital Image Sensor

The Omnivision OV6211 is a 1/10.5-Inch CMOS active pixel digital image sensor
with an active array size of 400H x 400V. It is programmable through a serial
I2C interface.

Required Properties:
- compatible: Value should be "ovti,ov6211".
- clocks: Reference to the xclk clock.
- clock-names: Should be "xclk".
- clock-frequency: Frequency of the xclk clock.
- reset-gpios: Chip reset GPIO. Polarity is GPIO_ACTIVE_HIGH. This corresponds
  to the hardware pin XSHUTDOWN which is physically active low.
- vdddo-supply: Chip digital IO regulator.
- vdda-supply: Chip analog regulator.
- vddd-supply: Chip digital core regulator.

The device node shall contain one 'port' child node with a single 'endpoint'
subnode for its digital output video port, in accordance with the video
interface bindings defined in
Documentation/devicetree/bindings/media/video-interfaces.txt.

Example:

	&i2c1 {
		...

		ov6211: camera-sensor@60 {
			compatible = "ovti,ov6211";
			reg = <0x60>;

			reset-gpios = <&gpio1 6 GPIO_ACTIVE_HIGH>;
			pinctrl-names = "default";
			pinctrl-0 = <&camera_bw_default>;

			clocks = <&clks 200>;
			clock-names = "xclk";
			clock-frequency = <24000000>;

			vdddo-supply = <&camera_dovdd_1v8>;
			vdda-supply = <&camera_avdd_2v8>;
			vddd-supply = <&camera_dvdd_1v2>;

			port {
				ov6211_ep: endpoint {
					clock-lanes = <1>;
					data-lanes = <0>;
					remote-endpoint = <&csi0_ep>;
				};
			};
		};
	};
```
